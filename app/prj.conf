## CMakeLists.txt
```
# Copyright (c) 2023 Jamie M.
# All right reserved. This code is not apache or FOSS/copyleft licensed.

cmake_minimum_required(VERSION 3.24.0)
find_package(Zephyr REQUIRED HINTS $ENV{ZEPHYR_BASE})
project(uart_esp)

target_sources(app PRIVATE src/main.c)
```

## Kconfig
```
# Copyright 2023 Jamie M.

menu "Application settings"

module = APPLICATION
module-str = application
source "subsys/logging/Kconfig.template.log_config"

menu "ESS profile listeners"

menuconfig APP_ESS_TEMPERATURE
	bool "Temperature"
	default y
	help
	  Enables subscribing to and outputting temperature readings.

menuconfig APP_ESS_HUMIDITY
	bool "Humidity"
	default y
	help
	  Enables subscribing to and outputting humidity readings.

menuconfig APP_ESS_PRESSURE
	bool "Pressure"
	help
	  Enables subscribing to and outputting pressure readings.

menuconfig APP_ESS_DEW_POINT
	bool "Dew point"
	help
	  Enables subscribing to and outputting dew point readings.

endmenu

choice
	prompt "Output format"
	default APP_OUTPUT_FORMAT_CSV

config APP_OUTPUT_FORMAT_CSV
	bool "CSV"
	help
	  Output will be in CSV format, with headings of each field.

config APP_OUTPUT_FORMAT_CUSTOM
	bool "Custom"
	help
	  Output will be in custom concise format, without headings

endchoice

endmenu

source "Kconfig.zephyr"
```

## prj.conf
```kconfig
# Copyright (c) 2023 Jamie M.
# All right reserved. This code is not apache or FOSS/copyleft licensed.

CONFIG_SENSOR=y
CONFIG_BOOTLOADER_MCUBOOT=y
CONFIG_MCUBOOT_GENERATE_UNSIGNED_IMAGE=y
CONFIG_LOG=n
CONFIG_NEWLIB_LIBC=y
CONFIG_NEWLIB_LIBC_FLOAT_PRINTF=y
CONFIG_FPU=y
CONFIG_SHELL=y
CONFIG_SHELL_PROMPT_UART=""
CONFIG_SHELL_ECHO_STATUS=n
CONFIG_SHELL_WILDCARD=n
CONFIG_SHELL_TAB=n
CONFIG_SHELL_VT100_COMMANDS=n
CONFIG_SHELL_METAKEYS=n
CONFIG_SHELL_HELP=n
CONFIG_SHELL_HISTORY=n
CONFIG_SHELL_STATS=n
CONFIG_SHELL_CMDS=n
CONFIG_DEVICE_SHELL=n
CONFIG_DEVMEM_SHELL=n
CONFIG_CLOCK_CONTROL_NRF_SHELL=n
CONFIG_BOOT_BANNER=n
CONFIG_SENSOR_SHELL=n
CONFIG_SPEED_OPTIMIZATIONS=y
CONFIG_REBOOT=y
```

## boards/bl654_sensor_board.overlay
```dts
&pwm0 {
	status = "disabled";
};

&radio {
	status = "disabled";
};

&ieee802154 {
	status = "disabled";
};
```

## src/main.c
```c
/*
 * Copyright (c) 2023 Jamie M.
 *
 * All right reserved. This code is not apache or FOSS/copyleft licensed.
 */

#include <stdio.h>
#include <zephyr/kernel.h>
#include <zephyr/device.h>
#include <zephyr/devicetree.h>
#include <zephyr/drivers/sensor.h>
#include <zephyr/shell/shell.h>

#include <zephyr/logging/log.h>
LOG_MODULE_REGISTER(abe, CONFIG_APPLICATION_LOG_LEVEL);

const struct device *const dev = DEVICE_DT_GET_ANY(bosch_bme280);
const uint8_t device_number = '0';

int main(void)
{
	if (!device_is_ready(dev)) {
		LOG_ERR("Device not ready");
		return -1;
	}

	return 0;
}

#if defined(CONFIG_APP_OUTPUT_FORMAT_CUSTOM)
#error "Not supported"
/* Outputs ESS readings in the following format:
 * Start delimiter: ##
 * { for each device with data:
 *     Index number: e.g. 0
 *     Temperature reading: e.g. 25.12
 *     Pressure reading: e.g. 1000270
 *     Humidity reading: e.g. 52.04
 *     Dew point reading: e.g. 8
 * }
 * End delimiter: ^^
 *
 * Each value has a comma (,) separator.
 */
static int ess_readings_handler(const struct shell *sh, size_t argc, char **argv)
{
	uint8_t i = 0;
	uint8_t buffer[128] = {0};

	while (i < DEVICE_COUNT) {
		if (devices[i].state == STATE_ACTIVE &&
		    devices[i].readings.received == RECEIVED_ALL) {
			sprintf(&buffer[strlen(buffer)], "%d,"
#ifdef CONFIG_APP_ESS_TEMPERATURE
				"%.2f,"
#endif
#ifdef CONFIG_APP_ESS_HUMIDITY
				"%.0f,"
#endif
#ifdef CONFIG_APP_ESS_PRESSURE
				"%.2f,"
#endif
#ifdef CONFIG_APP_ESS_DEW_POINT
				"%d,"
#endif
				, i
#ifdef CONFIG_APP_ESS_TEMPERATURE
				, devices[i].readings.temperature
#endif
#ifdef CONFIG_APP_ESS_HUMIDITY
				, devices[i].readings.humidity
#endif
#ifdef CONFIG_APP_ESS_PRESSURE
				, devices[i].readings.pressure
#endif
#ifdef CONFIG_APP_ESS_DEW_POINT
				, devices[i].readings.dew_point
#endif
				);
			devices[i].readings.received = RECEIVED_NONE;
		}

		++i;
	}

	if (strlen(buffer) > 0) {
		buffer[(strlen(buffer) - 1)] = 0;
	}

	shell_print(sh, "##%s^^", buffer);

	return 0;
}
#elif defined(CONFIG_APP_OUTPUT_FORMAT_CSV)
/* Outputs ESS readings in CSV format, with headings */
static int ess_readings_handler(const struct shell *sh, size_t argc, char **argv)
{
	uint8_t buffer[256] = {0};
#ifdef CONFIG_APP_ESS_TEMPERATURE
	struct sensor_value temperature;
#endif
#ifdef CONFIG_APP_ESS_HUMIDITY
	struct sensor_value humidity;
#endif
#ifdef CONFIG_APP_ESS_PRESSURE
	struct sensor_value pressure;
#endif
#ifdef CONFIG_APP_ESS_TEMPERATURE
	float temperature_float;
#endif
#ifdef CONFIG_APP_ESS_HUMIDITY
	float humidity_float;
#endif
#ifdef CONFIG_APP_ESS_PRESSURE
	float pressure_float;
#endif

	sensor_sample_fetch(dev);

#ifdef CONFIG_APP_ESS_TEMPERATURE
	sensor_channel_get(dev, SENSOR_CHAN_AMBIENT_TEMP, &temperature);
#endif
#ifdef CONFIG_APP_ESS_HUMIDITY
	sensor_channel_get(dev, SENSOR_CHAN_HUMIDITY, &humidity);
#endif
#ifdef CONFIG_APP_ESS_PRESSURE
	sensor_channel_get(dev, SENSOR_CHAN_PRESS, &pressure);
#endif

#ifdef CONFIG_APP_ESS_TEMPERATURE
	temperature_float = sensor_value_to_float(&temperature);
#endif
#ifdef CONFIG_APP_ESS_HUMIDITY
	humidity_float = sensor_value_to_float(&humidity);
#endif
#ifdef CONFIG_APP_ESS_PRESSURE
	pressure_float = sensor_value_to_float(&pressure);
#endif

	sprintf(&buffer[0], "device,"
#ifdef CONFIG_APP_ESS_TEMPERATURE
		"temperature,"
#endif
#ifdef CONFIG_APP_ESS_HUMIDITY
		"humidity,"
#endif
#ifdef CONFIG_APP_ESS_PRESSURE
		"pressure,"
#endif
#ifdef CONFIG_APP_ESS_DEW_POINT
		"dewpoint,"
#endif
		"\n");

	sprintf(&buffer[strlen(buffer)], "%c,"
#ifdef CONFIG_APP_ESS_TEMPERATURE
		"%.2f,"
#endif
#ifdef CONFIG_APP_ESS_HUMIDITY
		"%.2f,"
#endif
#ifdef CONFIG_APP_ESS_PRESSURE
		"%.0f,"
#endif
#ifdef CONFIG_APP_ESS_DEW_POINT
		"%d,"
#endif
		"\n", device_number
#ifdef CONFIG_APP_ESS_TEMPERATURE
		, temperature_float
#endif
#ifdef CONFIG_APP_ESS_HUMIDITY
		, humidity_float
#endif
#ifdef CONFIG_APP_ESS_PRESSURE
		, pressure_float
#endif
#ifdef CONFIG_APP_ESS_DEW_POINT
		, TODO
#endif
		);

	shell_print(sh, "%s\n", buffer);

	return 0;
}
#else
#error "Invalid output format selected"
#endif

static int ess_status_handler(const struct shell *sh, size_t argc, char **argv)
{
	if (device_is_ready(dev)) {
		shell_print(sh, "Ready!");
	} else {
		shell_error(sh, "Error");
	}

	return 0;
}

SHELL_STATIC_SUBCMD_SET_CREATE(ess_cmd,
	/* Command handlers */
	SHELL_CMD(readings, NULL, "Output ESS values", ess_readings_handler),
	SHELL_CMD(status, NULL, "Show device status", ess_status_handler),

	/* Array terminator. */
	SHELL_SUBCMD_SET_END
);

SHELL_CMD_REGISTER(ess, &ess_cmd, "ESS profile commands", NULL);
```

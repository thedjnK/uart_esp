## bl654/Kconfig
```kconfig
config BL654_SB_LEAVE_SPACE
	bool "Leave space for sB bootloader"
	help
	  Leaves a space where the BL654 sB bootloader string can be placed.

config BL654_SB_PERUSER_ERASE
	bool "Return to sB bootloader on stat serial recovery command"
	default y
	depends on ENABLE_MGMT_PERUSER
	help
	  This allows returning back to the sB bootloader from MCUboot serial recovery mode by
	  issuing any command which targets the stat group.
```

## boards/arm/bl654_sensor_board_no_sb/Kconfig
```kconfig
# BL654 Sensor Board configuration

# Copyright (c) 2021 Laird Connectivity
# Copyright (c) 2023 Jamie M.
# SPDX-License-Identifier: Apache-2.0

config BOARD_ENABLE_DCDC
	bool "DCDC mode"
	select SOC_DCDC_NRF52X
	default y
	depends on BOARD_BL654_SENSOR_BOARD_NO_SB
```

## boards/arm/bl654_sensor_board_no_sb/Kconfig.defconfig
```kconfig
# BL654 Sensor Board configuration

# Copyright (c) 2021 Laird Connectivity
# SPDX-License-Identifier: Apache-2.0

if BOARD_BL654_SENSOR_BOARD_NO_SB

config BOARD
	default "bl654_sensor_board_no_sb"

endif # BOARD_BL654_SENSOR_BOARD
```
